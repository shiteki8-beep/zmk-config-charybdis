## config/west.yml
```yaml
manifest:
  remotes:
    - name: zmkfirmware
      url_base: https://github.com
  projects:
    - name: zmk
      remote: zmkfirmware
      revision: v0.7.0
      import: app/west.yml
  self:
    path: config
```
